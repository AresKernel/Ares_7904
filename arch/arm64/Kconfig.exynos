## arch/arm64/Kconfig.exynos
```kconfig
config MACH_EXYNOS7885_A30_GLOBAL
	bool "Build Dtbo image for SM-A305"
	depends on SOC_EXYNOS7885
	default n
	help
	Say Y here if you want to enable building dtbo for Galaxy A30.

config MACH_EXYNOS7885_A30S_GLOBAL
	bool "Build Dtbo image for SM-A307"
	depends on SOC_EXYNOS7885
	default n
	help
	Say Y here if you want to enable building dtbo for Galaxy A30s.

config MACH_EXYNOS7885_A40_GLOBAL
	bool "Build Dtbo image for SM-A405"
	depends on SOC_EXYNOS7885
	default n
	help
	Say Y here if you want to enable building dtbo for Galaxy A40.
```

## arch/arm64/configs/exynos7885-ares_defconfig
```kconfig
# AresKernel configuration file
CONFIG_ZRAM=y
CONFIG_CRYPTO_ZSTD=y
# CONFIG_FRONTSWAP is not set
# CONFIG_ZSWAP is not set
# CONFIG_ZSWAP_MIGRATION_SUPPORT is not set
# CONFIG_DIRECT_RECLAIM_FILE_PAGES_ONLY is not set
# CONFIG_INCREASE_MAXIMUM_SWAPPINESS is not set
# CONFIG_FIX_INACTIVE_RATIO is not set
# CONFIG_TIGHT_PGDAT_BALANCE is not set
# CONFIG_VNSWAP is not set
CONFIG_CPU_QUIET=y
CONFIG_CPU_QUIET_GOVERNOR_USERSPACE=y
CONFIG_CPU_QUIET_GOVERNOR_RUNNABLE=y
CONFIG_CPU_QUIET_GOVERNOR_RQBALANCE=y
CONFIG_CPU_QUIET_DEFAULT_GOV_USERSPACE=y
# CONFIG_CPU_QUIET_DEFAULT_GOV_RUNNABLE is not set
# CONFIG_CPU_QUIET_DEFAULT_GOV_RQBALANCE is not set
CONFIG_CPU_QUIET_EXYNOS=y
CONFIG_CPU_BOOST=y
CONFIG_WQ_POWER_EFFICIENT_DEFAULT=y
# CONFIG_CC_OPTIMIZE_FOR_PERFORMANCE is not set
CONFIG_CC_OPTIMIZE_FOR_PERFORMANCE_O3_OFAST_SUB_OPTIONS=y
# CONFIG_CC_OPTIMIZE_FOR_SIZE is not set
# CONFIG_CC_STACKPROTECTOR is not set
CONFIG_CC_STACKPROTECTOR_NONE=y
# CONFIG_CC_STACKPROTECTOR_STRONG is not set
CONFIG_RCU_EXPERT=y
CONFIG_SRCU=y
# CONFIG_TASKS_RCU is not set
CONFIG_RCU_STALL_COMMON=y
CONFIG_RCU_FANOUT=64
CONFIG_RCU_FANOUT_LEAF=16
# CONFIG_RCU_FAST_NO_HZ is not set
# CONFIG_TREE_RCU_TRACE is not set
CONFIG_RCU_BOOST=y
CONFIG_RCU_KTHREAD_PRIO=1
CONFIG_RCU_BOOST_DELAY=500
# CONFIG_RCU_NOCB_CPU is not set
# CONFIG_RCU_EXPEDITE_BOOT is not set
CONFIG_ARCH_HAS_FAST_MULTIPLIER=y
CONFIG_DEFAULT_MNT_NOATIME=y
# CONFIG_DEFAULT_MNT_RELATIME is not set
CONFIG_IOSCHED_DEADLINE=y
CONFIG_IOSCHED_FIOPS=y
CONFIG_IOSCHED_SIO=y
# CONFIG_DEFAULT_DEADLINE is not set
# CONFIG_DEFAULT_SIO is not set
# CONFIG_DEFAULT_FIOPS is not set
CONFIG_FRANDOM=y
CONFIG_STATE_NOTIFIER=y
CONFIG_DYNAMIC_FSYNC=y
CONFIG_CPU_FREQ_GOV_COMMON=y
CONFIG_CPU_FREQ_GOV_ONDEMAND=y
CONFIG_DEVFREQ_BOOST=y
CONFIG_DEVFREQ_INPUT_BOOST_DURATION_MS=1000
CONFIG_DEVFREQ_EXYNOS_MIF_BOOST_FREQ=1539000
CONFIG_POWERSUSPEND=y
# CONFIG_POWERSUSPEND_DEBUG is not set
CONFIG_BOEFFLA_WL_BLOCKER=y
```
